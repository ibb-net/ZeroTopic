## Middlewares/device/timer_decoder/Kconfig
```kconfig
config TIMER_DECODER_EN
    bool "正交译码器功能使能"
    default n
    help
        Enable support for the timer decoder functionality. This includes


config TIMER_DECODER_CHANNEL_MAX
    int "正交译码器通道数量"
    default 1
    depends on TIMER_DECODER_EN
    range 1 2
    help
        Set the number of timer decoder channels to be used. This can be set to 1 or 2.    
config TIMER_DECODER_CH0_EN
    bool "通道0使能"
    default y
    depends on TIMER_DECODER_EN
    help
        Enable support for Timer Decoder Channel 1. This includes GPIO, timer configurations, and other related settings.

choice
    prompt "选择通道0的定时器配置"
    depends on TIMER_DECODER_CH0_EN
    default ENCODER_CH0_TIMER_0

config ENCODER_CH0_TIMER_0
    bool "Timer 0"

config ENCODER_CH0_TIMER_1
    bool "Timer 1"

config ENCODER_CH0_TIMER_2
    bool "Timer 2"

config ENCODER_CH0_TIMER_3
    bool "Timer 3"

config ENCODER_CH0_TIMER_4
    bool "Timer 4"

config ENCODER_CH0_TIMER_5
    bool "Timer 5"

config ENCODER_CH0_TIMER_6
    bool "Timer 6"

config ENCODER_CH0_TIMER_7
    bool "Timer 7"

config ENCODER_CH0_TIMER_14
    bool "Timer 14"

config ENCODER_CH0_TIMER_15
    bool "Timer 15"

config ENCODER_CH0_TIMER_16
    bool "Timer 16"

config ENCODER_CH0_TIMER_22
    bool "Timer 22"

config ENCODER_CH0_TIMER_23
    bool "Timer 23"

config ENCODER_CH0_TIMER_30
    bool "Timer 30"

config ENCODER_CH0_TIMER_31
    bool "Timer 31"

config ENCODER_CH0_TIMER_40
    bool "Timer 40"

config ENCODER_CH0_TIMER_41
    bool "Timer 41"

config ENCODER_CH0_TIMER_42
    bool "Timer 42"

config ENCODER_CH0_TIMER_43
    bool "Timer 43"

config ENCODER_CH0_TIMER_44
    bool "Timer 44"

config ENCODER_CH0_TIMER_50
    bool "Timer 50"

config ENCODER_CH0_TIMER_51
    bool "Timer 51"

endchoice

config ENCODER_CH0_TIMER
    int
    depends on TIMER_DECODER_CH0_EN
    default TIMER0 if ENCODER_CH0_TIMER_0
    default TIMER1 if ENCODER_CH0_TIMER_1
    default TIMER2 if ENCODER_CH0_TIMER_2
    default TIMER3 if ENCODER_CH0_TIMER_3
    default TIMER4 if ENCODER_CH0_TIMER_4
    default TIMER5 if ENCODER_CH0_TIMER_5
    default TIMER6 if ENCODER_CH0_TIMER_6
    default TIMER7 if ENCODER_CH0_TIMER_7
    default TIMER14 if ENCODER_CH0_TIMER_14
    default TIMER15 if ENCODER_CH0_TIMER_15
    default TIMER16 if ENCODER_CH0_TIMER_16
    default TIMER22 if ENCODER_CH0_TIMER_22
    default TIMER23 if ENCODER_CH0_TIMER_23
    default TIMER30 if ENCODER_CH0_TIMER_30
    default TIMER31 if ENCODER_CH0_TIMER_31
    default TIMER40 if ENCODER_CH0_TIMER_40
    default TIMER41 if ENCODER_CH0_TIMER_41
    default TIMER42 if ENCODER_CH0_TIMER_42
    default TIMER43 if ENCODER_CH0_TIMER_43
    default TIMER44 if ENCODER_CH0_TIMER_44
    default TIMER50 if ENCODER_CH0_TIMER_50
    default TIMER51 if ENCODER_CH0_TIMER_51

config ENCODER_CH0_TIMER_RCU
    int
    depends on TIMER_DECODER_CH0_EN
    default RCU_TIMER0 if ENCODER_CH0_TIMER_0
    default RCU_TIMER1 if ENCODER_CH0_TIMER_1
    default RCU_TIMER2 if ENCODER_CH0_TIMER_2
    default RCU_TIMER3 if ENCODER_CH0_TIMER_3
    default RCU_TIMER4 if ENCODER_CH0_TIMER_4
    default RCU_TIMER5 if ENCODER_CH0_TIMER_5
    default RCU_TIMER6 if ENCODER_CH0_TIMER_6
    default RCU_TIMER7 if ENCODER_CH0_TIMER_7
    default RCU_TIMER14 if ENCODER_CH0_TIMER_14
    default RCU_TIMER15 if ENCODER_CH0_TIMER_15
    default RCU_TIMER16 if ENCODER_CH0_TIMER_16
    default RCU_TIMER22 if ENCODER_CH0_TIMER_22
    default RCU_TIMER23 if ENCODER_CH0_TIMER_23
    default RCU_TIMER30 if ENCODER_CH0_TIMER_30
    default RCU_TIMER31 if ENCODER_CH0_TIMER_31
    default RCU_TIMER40 if ENCODER_CH0_TIMER_40
    default RCU_TIMER41 if ENCODER_CH0_TIMER_41
    default RCU_TIMER42 if ENCODER_CH0_TIMER_42
    default RCU_TIMER43 if ENCODER_CH0_TIMER_43
    default RCU_TIMER44 if ENCODER_CH0_TIMER_44
    default RCU_TIMER50 if ENCODER_CH0_TIMER_50
    default RCU_TIMER51 if ENCODER_CH0_TIMER_51

menu "通道0步进模式配置"
    depends on TIMER_DECODER_CH0_EN

config TIMER_DECODER_CH0_STEP0
    int "通道0步进模式"
    default 0
    help
        Configure the step mode for Timer Decoder Channel 0.Unused -1

config TIMER_DECODER_CH0_STEP1
    int "通道1步进模式"
    default 400
    help
        Configure the step mode for Timer Decoder Channel 1.Unused -1
config TIMER_DECODER_CH0_STEP2
    int "通道2步进模式"
    default 800
    help
        Configure the step mode for Timer Decoder Channel 2.Unused -1
        
config TIMER_DECODER_CH0_STEP3
    int "通道3步进模式"
    default 1200
    help
        Configure the step mode for Timer Decoder Channel 3.Unused -1
config TIMER_DECODER_CH0_STEP4
    int "通道4步进模式"
    default 1600
    help
        Configure the step mode for Timer Decoder Channel 4.Unused -1
config TIMER_DECODER_CH0_STEP5
    int "通道5步进模式"
    default 2000
    help
        Configure the step mode for Timer Decoder Channel 5.Unused -1
config TIMER_DECODER_CH0_STEP6
    int "通道6步进模式"
    default 2400
    help
        Configure the step mode for Timer Decoder Channel 6.Unused -1
config TIMER_DECODER_CH0_STEP7
    int "通道7步进模式"
    default 2800
    help
        Configure the step mode for Timer Decoder Channel 7.Unused -1
config TIMER_DECODER_CH0_STEP8
    int "通道8步进模式"
    default 3200
    help
        Configure the step mode for Timer Decoder Channel 8.Unused -1
config TIMER_DECODER_CH0_STEP9
    int "通道9步进模式"
    default 3600
    help
        Configure the step mode for Timer Decoder Channel 9.Unused -1
config TIMER_DECODER_CH0_STEP10
    int "通道10步进模式"
    default 4000
    help
        Configure the step mode for Timer Decoder Channel 10.Unused -1
config TIMER_DECODER_CH0_STEP11
    int "通道11步进模式"
    default -1
    help
        Configure the step mode for Timer Decoder Channel 11.Unused -1
config TIMER_DECODER_CH0_STEP12
    int "通道12步进模式"
    default -1
    help
        Configure the step mode for Timer Decoder Channel 12.Unused -1
config TIMER_DECODER_CH0_STEP13
    int "通道13步进模式"
    default -1
    help
        Configure the step mode for Timer Decoder Channel 13.Unused -1
config TIMER_DECODER_CH0_STEP14
    int "通道14步进模式"
    default -1
    help
        Configure the step mode for Timer Decoder Channel 14.Unused -1
config TIMER_DECODER_CH0_STEP15
    int "通道15步进模式"
    default -1
    help
        Configure the step mode for Timer Decoder Channel 15.Unused -1
   
    
endmenu







config TIMER_DECODER_CH1_EN
    bool "通道1使能"
    default y
    depends on TIMER_DECODER_EN
    help
        Enable support for Timer Decoder Channel 1. This includes GPIO, timer configurations, and other related settings.


choice
    prompt "选择通道1的定时器配置"
    depends on TIMER_DECODER_CH1_EN
    default ENCODER_CH1_TIMER_0

config ENCODER_CH1_TIMER_0
    bool "Timer 0"

config ENCODER_CH1_TIMER_1
    bool "Timer 1"

config ENCODER_CH1_TIMER_2
    bool "Timer 2"

config ENCODER_CH1_TIMER_3
    bool "Timer 3"

config ENCODER_CH1_TIMER_4
    bool "Timer 4"

config ENCODER_CH1_TIMER_5
    bool "Timer 5"

config ENCODER_CH1_TIMER_6
    bool "Timer 6"

config ENCODER_CH1_TIMER_7
    bool "Timer 7"

config ENCODER_CH1_TIMER_14
    bool "Timer 14"

config ENCODER_CH1_TIMER_15
    bool "Timer 15"

config ENCODER_CH1_TIMER_16
    bool "Timer 16"

config ENCODER_CH1_TIMER_22
    bool "Timer 22"

config ENCODER_CH1_TIMER_23
    bool "Timer 23"

config ENCODER_CH1_TIMER_30
    bool "Timer 30"

config ENCODER_CH1_TIMER_31
    bool "Timer 31"

config ENCODER_CH1_TIMER_40
    bool "Timer 40"

config ENCODER_CH1_TIMER_41
    bool "Timer 41"

config ENCODER_CH1_TIMER_42
    bool "Timer 42"

config ENCODER_CH1_TIMER_43
    bool "Timer 43"

config ENCODER_CH1_TIMER_44
    bool "Timer 44"

config ENCODER_CH1_TIMER_50
    bool "Timer 50"

config ENCODER_CH1_TIMER_51
    bool "Timer 51"

endchoice

config ENCODER_CH1_TIMER
    int
    depends on TIMER_DECODER_CH1_EN
    default TIMER0 if ENCODER_CH1_TIMER_0
    default TIMER1 if ENCODER_CH1_TIMER_1
    default TIMER2 if ENCODER_CH1_TIMER_2
    default TIMER3 if ENCODER_CH1_TIMER_3
    default TIMER4 if ENCODER_CH1_TIMER_4
    default TIMER5 if ENCODER_CH1_TIMER_5
    default TIMER6 if ENCODER_CH1_TIMER_6
    default TIMER7 if ENCODER_CH1_TIMER_7
    default TIMER14 if ENCODER_CH1_TIMER_14
    default TIMER15 if ENCODER_CH1_TIMER_15
    default TIMER16 if ENCODER_CH1_TIMER_16
    default TIMER22 if ENCODER_CH1_TIMER_22
    default TIMER23 if ENCODER_CH1_TIMER_23
    default TIMER30 if ENCODER_CH1_TIMER_30
    default TIMER31 if ENCODER_CH1_TIMER_31
    default TIMER40 if ENCODER_CH1_TIMER_40
    default TIMER41 if ENCODER_CH1_TIMER_41
    default TIMER42 if ENCODER_CH1_TIMER_42
    default TIMER43 if ENCODER_CH1_TIMER_43
    default TIMER44 if ENCODER_CH1_TIMER_44
    default TIMER50 if ENCODER_CH1_TIMER_50
    default TIMER51 if ENCODER_CH1_TIMER_51

config ENCODER_CH1_TIMER_RCU
    int
    depends on TIMER_DECODER_CH1_EN
    default RCU_TIMER0 if ENCODER_CH1_TIMER_0
    default RCU_TIMER1 if ENCODER_CH1_TIMER_1
    default RCU_TIMER2 if ENCODER_CH1_TIMER_2
    default RCU_TIMER3 if ENCODER_CH1_TIMER_3
    default RCU_TIMER4 if ENCODER_CH1_TIMER_4
    default RCU_TIMER5 if ENCODER_CH1_TIMER_5
    default RCU_TIMER6 if ENCODER_CH1_TIMER_6
    default RCU_TIMER7 if ENCODER_CH1_TIMER_7
    default RCU_TIMER14 if ENCODER_CH1_TIMER_14
    default RCU_TIMER15 if ENCODER_CH1_TIMER_15
    default RCU_TIMER16 if ENCODER_CH1_TIMER_16
    default RCU_TIMER22 if ENCODER_CH1_TIMER_22
    default RCU_TIMER23 if ENCODER_CH1_TIMER_23
    default RCU_TIMER30 if ENCODER_CH1_TIMER_30
    default RCU_TIMER31 if ENCODER_CH1_TIMER_31
    default RCU_TIMER40 if ENCODER_CH1_TIMER_40
    default RCU_TIMER41 if ENCODER_CH1_TIMER_41
    default RCU_TIMER42 if ENCODER_CH1_TIMER_42
    default RCU_TIMER43 if ENCODER_CH1_TIMER_43
    default RCU_TIMER44 if ENCODER_CH1_TIMER_44
    default RCU_TIMER50 if ENCODER_CH1_TIMER_50
    default RCU_TIMER51 if ENCODER_CH1_TIMER_51



menu   "通道1步进模式配置"
    depends on TIMER_DECODER_CH1_EN
config TIMER_DECODER_CH1_STEP0
    int "通道0步进模式"
    default 0
    help
        Configure the step mode for Timer Decoder Channel 0.Unused -1

config TIMER_DECODER_CH1_STEP1
    int "通道1步进模式"
    default 400
    help
        Configure the step mode for Timer Decoder Channel 1.Unused -1
config TIMER_DECODER_CH1_STEP2
    int "通道2步进模式"
    default 800
    help
        Configure the step mode for Timer Decoder Channel 2.Unused -1
config TIMER_DECODER_CH1_STEP3
    int "通道3步进模式"
    default 1200
    help
        Configure the step mode for Timer Decoder Channel 3.Unused -1
config TIMER_DECODER_CH1_STEP4
    int "通道4步进模式"
    default 1600
    help
        Configure the step mode for Timer Decoder Channel 4.Unused -1

config TIMER_DECODER_CH1_STEP5
    int "通道5步进模式"
    default 2000
    help
        Configure the step mode for Timer Decoder Channel 5.Unused -1
config TIMER_DECODER_CH1_STEP6
    int "通道6步进模式"
    default 2400
    help
        Configure the step mode for Timer Decoder Channel 6.Unused -1
config TIMER_DECODER_CH1_STEP7
    int "通道7步进模式"
    default 2800
    help
        Configure the step mode for Timer Decoder Channel 7.Unused -1
config TIMER_DECODER_CH1_STEP8
    int "通道8步进模式"
    default 3200
    help
        Configure the step mode for Timer Decoder Channel 8.Unused -1
config TIMER_DECODER_CH1_STEP9
    int "通道9步进模式"
    default 3600
    help
        Configure the step mode for Timer Decoder Channel 9.Unused -1
config TIMER_DECODER_CH1_STEP10
    int "通道10步进模式"
    default 4000
    help
        Configure the step mode for Timer Decoder Channel 10.Unused -1
config TIMER_DECODER_CH1_STEP11
    int "通道11步进模式"
    default -1
    help
        Configure the step mode for Timer Decoder Channel 11.Unused -1
config TIMER_DECODER_CH1_STEP12
    int "通道12步进模式"
    default -1
    help
        Configure the step mode for Timer Decoder Channel 12.Unused -1
config TIMER_DECODER_CH1_STEP13
    int "通道13步进模式"
    default -1
    help
        Configure the step mode for Timer Decoder Channel 13.Unused -1
config TIMER_DECODER_CH1_STEP14
    int "通道14步进模式"
    default -1
    help
        Configure the step mode for Timer Decoder Channel 14.Unused -1
config TIMER_DECODER_CH1_STEP15
    int "通道15步进模式"
    default -1
    help
        Configure the step mode for Timer Decoder Channel 15.Unused -1
endmenu
```

## OS/Kconfig
```kconfig
config KCONFIG_DEMO_ITEM1
    bool
    prompt "demonstate item1 for bool learning"

config KCONFIG_DEMO_ITEM2
    string
    prompt "demonstate item2 for string learning"

config KCONFIG_DEMO_ITEM3
    hex
    prompt "demonstate item3 for hex learning"

menuconfig KCONFIG_DEMO_MENUCONFIG1
    bool
    prompt "menuconfig learning"

if KCONFIG_DEMO_MENUCONFIG1

config MENUCONFIG_SUBITEM1
    bool
    prompt "menuconfig subitem1"

config MENUCONFIG_SUBITEM2
    bool
    prompt "menuconfig subitem2"

endif

menu "menu learning"

config MENU_SUBITEM1
        bool
        prompt "subitem1"

config MENU_SUBITEM2
        bool
        prompt "subitem2"

config MENU_SUBITEM3
        bool
        prompt "subitem3"

endmenu



choice 
        bool
        prompt "choice learning"

config CHOICE_ITEM1
        bool
        prompt "choice1"

config CHOICE_ITEM2
        bool
        prompt "choice2"

config CHOICE_ITEM3
        bool
        prompt "choice3"
endchoice


config MY_CONFIG1
        bool
        prompt "my config1"

config MY_CONFIG2
        bool
        prompt "my config2" if MY_CONFIG1

config MY_CONFIG3
        bool
        prompt "my config3"
        depends on MY_CONFIG2
```
